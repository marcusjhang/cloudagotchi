## firmware/main/Kconfig.projbuild
```kconfig
menu "Cloudagotchi Configuration"

    config CLOUDAGOTCHI_WIFI_SSID
        string "Wi-Fi SSID"
        default "my-wifi"

    config CLOUDAGOTCHI_WIFI_PASSWORD
        string "Wi-Fi password"
        default ""

    config CLOUDAGOTCHI_IOT_ENDPOINT
        string "AWS IoT endpoint"
        default "xxxxxxxxxxxxx-ats.iot.us-east-1.amazonaws.com"
        help
            Find yours with:
            aws iot describe-endpoint --endpoint-type iot:Data-ATS

    config CLOUDAGOTCHI_THING_NAME
        string "Thing name"
        default "cloudagotchi-01"
        help
            Must match the thing created by scripts/provision-device.sh —
            the IoT policy only allows connecting with this as client id.

endmenu
```
